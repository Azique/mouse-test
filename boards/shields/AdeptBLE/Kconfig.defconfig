## boards/shields/AdeptBLE/Kconfig.defconfig
```kconfig
if SHIELD_TB9070BLE

config ZMK_KEYBOARD_NAME
    default "TB9070BLE"

endif

config SPI
	default y
```

## config/west.yml
```yaml
manifest:
  remotes:
    - name: zmkfirmware
      url-base: https://github.com/zmkfirmware
    - name: Broeserl
      url-base: https://github.com/Broeserl/
    # - name: cyboard
    #   url-base: https://github.com/Cyboard-DigitalTailor
  projects:
    - name: zmk
      remote: zmkfirmware
      revision: main
      import: app/west.yml
    - name: zmk-pmw3360-driver
      remote: Broeserl
      revision: main
    # - name: zmk-pmw3610-driver
    #   remote: cyboard
    #   revision: startup_optimization
  self:
    path: config
```
